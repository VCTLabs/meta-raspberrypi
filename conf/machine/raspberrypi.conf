## conf/machine/raspberrypi.conf
```bitbake
#@TYPE: Machine
#@NAME: RaspberryPi Development Board
#@DESCRIPTION: Machine configuration for the RaspberryPi http://www.raspberrypi.org/ Board

#MACHINE_KERNEL_PR = "r5"

include conf/machine/include/rpi-base.inc

# alternate config (hardfloat vfp nothumb)
require conf/machine/include/tune-arm1176jzfs.inc
DEFAULTTUNE = "arm1176jzfs"
TUNE_FEATURES_append = " no-thumb-interwork"
```
